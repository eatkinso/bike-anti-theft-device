# file: KMS_Embedded_RSA_Key.ioc
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KMS.KMS_ATTRIBUTES=//\#define KMS_ATTRIBUTES
KMS.KMS_DECRYPT=//\#define KMS_DECRYPT
KMS.KMS_DERIVE_KEY=//\#define KMS_DERIVE_KEY
KMS.KMS_DIGEST=\#define KMS_DIGEST
KMS.KMS_EC_SECP192=//\#define KMS_EC_SECP192
KMS.KMS_EC_SECP256=//\#define KMS_EC_SECP256
KMS.KMS_EC_SECP384=//\#define KMS_EC_SECP384
KMS.KMS_ENCRYPT=//\#define KMS_ENCRYPT
KMS.KMS_IMPORT_BLOB=//\#define KMS_IMPORT_BLOB
KMS.KMS_MEM_CLEANING=\#define KMS_MEM_CLEANING
KMS.KMS_MEM_DEBUGGING=\#define KMS_MEM_DEBUGGING
KMS.KMS_MEM_LOGGING=//\#define KMS_MEM_LOGGING
KMS.KMS_MEM_USE_ALLOCATOR=KMS_MEM_USE_HEAP_ALLOCATOR
KMS.KMS_NB_SESSIONS_MAX=1
KMS.KMS_NIKMS_ROUTER_BYPASS=\#define KMS_NIKMS_ROUTER_BYPASS
KMS.KMS_NVM_DYNAMIC_ENABLED=//\#define KMS_NVM_DYNAMIC_ENABLED
KMS.KMS_NVM_ENABLED=//\#define KMS_NVM_ENABLED
KMS.KMS_OBJECTS=//\#define KMS_OBJECTS
KMS.KMS_PKCS11_COMPLIANCE=//\#define KMS_PKCS11_COMPLIANCE
KMS.KMS_PKCS11_GET_FUNCTION_LIST_SUPPORT=//\#define KMS_PKCS11_GET_FUNCTION_LIST_SUPPORT
KMS.KMS_RSA=KMS_FCT_SIGN|KMS_FCT_VERIFY
KMS.KMS_RSA_1024=//\#define KMS_RSA_1024
KMS.KMS_RSA_2048=\#define KMS_RSA_2048
KMS.KMS_SEARCH=//\#define KMS_SEARCH
KMS.KMS_SHA1=KMS_FCT_DIGEST
KMS.KMS_SIGN=\#define KMS_SIGN
KMS.KMS_VERIFY=\#define KMS_VERIFY
KMS.KMS_VM_DYNAMIC_ENABLED=//\#define KMS_VM_DYNAMIC_ENABLED
Mcu.Family=STM32WL
Mcu.Name=STM32WL55JCIx
Mcu.Package=UFBGA73
NVIC.PriorityGroup=NVIC_PRIORITYGROUP_4
ProjectManager.HeapSize=0x400
ProjectManager.StackSize=0x500
ProjectManager.TargetToolchain=EWARM V8
RCC.AHBFreq_Value=48000000
RCC.APB1Freq_Value=48000000
RCC.APB1TimFreq_Value=48000000
RCC.APB2Freq_Value=48000000
RCC.APB2TimFreq_Value=48000000
RCC.APB3Freq_Value=48000000
RCC.CortexFreq_Value=48000000
RCC.HCLKFreq_Value=48000000
RCC.HSE_VALUE=8000000
RCC.HSI_VALUE=16000000
RCC.LSE_VALUE=32768
RCC.MSIClockRange=RCC_MSIRANGE_8
RCC.PLLM=RCC_PLLM_DIV4
RCC.PLLN=24
RCC.SYSCLKFreq_VALUE=48000000
RCC.SYSCLKSource=RCC_SYSCLKSOURCE_PLLCLK
RCC.VCOOutputFreq_Value=96000000
VP_KMS_VS_KMS.Mode=KMS_Enabled
board=custom

// file: Src/main.c
/* USER CODE BEGIN Header */
/**
  ******************************************************************************
  * @file           : main.c
  * @brief          : Main program body
  ******************************************************************************
  * @attention
  *
  * <h2><center>&copy; Copyright (c) 2020 STMicroelectronics.
  * All rights reserved.</center></h2>
  *
  * This software component is licensed by ST under Ultimate Liberty license
  * SLA0044, the "License"; You may not use this file except in compliance with
  * the License. You may obtain a copy of the License at:
  *                             www.st.com/SLA0044
  *
  ******************************************************************************
  */
/* USER CODE END Header */
#include "main.h"

/* USER CODE BEGIN Includes */
#include "stm32wlxx_nucleo.h"
#include "com.h"
/* USER CODE END Includes */

/* USER CODE BEGIN PV */
static uint8_t clear_buffer[128] = "STM32 Key Management Services - Example buffer";
/* USER CODE END PV */

void SystemClock_Config(void);

int main(void)
{
  /* USER CODE BEGIN 1 */
  CK_RV ret_status;
  /* USER CODE END 1 */

  /* MCU Configuration--------------------------------------------------------*/

  /* Reset of all peripherals, Initializes the Flash interface and the Systick. */
  HAL_Init();

  /* Configure the system clock */
  SystemClock_Config();

  /* USER CODE BEGIN SysInit */
  /* Configure Communication module */
  COM_Init();
  /* USER CODE END SysInit */

  /* Initialize all configured peripherals */
  MX_KMS_Init();
  /* USER CODE BEGIN 2 */
  /* Initialize LED on board */
  BSP_LED_Init(LED3);

  /* USER CODE END 2 */

  /* Infinite loop */
  /* USER CODE BEGIN WHILE */
  ret_status = app_kms_sign_verify_rsa(sizeof(clear_buffer), clear_buffer);
  printf("RSA test %s\r\n", (ret_status == CKR_OK) ? "SUCCESSFUL" : "FAILED");
  if (ret_status != CKR_OK)
  {
    Error_Handler();
  }
  else
  {
    /* Turn LED3 on to signify end of test with success status */
    BSP_LED_On(LED3);
  }
  while (1)
  {
    /* USER CODE END WHILE */

  }
}

void SystemClock_Config(void)
{
  RCC_OscInitTypeDef RCC_OscInitStruct = {0};
  RCC_ClkInitTypeDef RCC_ClkInitStruct = {0};

  /** Configure the main internal regulator output voltage
  */
  __HAL_PWR_VOLTAGESCALING_CONFIG(PWR_REGULATOR_VOLTAGE_SCALE1);
  /** Initializes the CPU, AHB and APB busses clocks
  */
  RCC_OscInitStruct.OscillatorType = RCC_OSCILLATORTYPE_MSI;
  RCC_OscInitStruct.MSIState = RCC_MSI_ON;
  RCC_OscInitStruct.MSICalibrationValue = RCC_MSICALIBRATION_DEFAULT;
  RCC_OscInitStruct.MSIClockRange = RCC_MSIRANGE_8;
  RCC_OscInitStruct.PLL.PLLState = RCC_PLL_ON;
  RCC_OscInitStruct.PLL.PLLSource = RCC_PLLSOURCE_MSI;
  RCC_OscInitStruct.PLL.PLLM = RCC_PLLM_DIV4;
  RCC_OscInitStruct.PLL.PLLN = 24;
  RCC_OscInitStruct.PLL.PLLP = RCC_PLLP_DIV2;
  RCC_OscInitStruct.PLL.PLLR = RCC_PLLR_DIV2;
  RCC_OscInitStruct.PLL.PLLQ = RCC_PLLQ_DIV2;
  if (HAL_RCC_OscConfig(&RCC_OscInitStruct) != HAL_OK)
  {
    Error_Handler();
  }
  /** Configure the SYSCLKSource, HCLK, PCLK1 and PCLK2 clocks dividers
  */
  RCC_ClkInitStruct.ClockType = RCC_CLOCKTYPE_HCLK3|RCC_CLOCKTYPE_HCLK
                              |RCC_CLOCKTYPE_SYSCLK|RCC_CLOCKTYPE_PCLK1
                              |RCC_CLOCKTYPE_PCLK2;
  RCC_ClkInitStruct.SYSCLKSource = RCC_SYSCLKSOURCE_PLLCLK;
  RCC_ClkInitStruct.AHBCLKDivider = RCC_SYSCLK_DIV1;
  RCC_ClkInitStruct.APB1CLKDivider = RCC_HCLK_DIV1;
  RCC_ClkInitStruct.APB2CLKDivider = RCC_HCLK_DIV1;
  RCC_ClkInitStruct.AHBCLK3Divider = RCC_SYSCLK_DIV1;

  if (HAL_RCC_ClockConfig(&RCC_ClkInitStruct, FLASH_LATENCY_2) != HAL_OK)
  {
    Error_Handler();
  }
}

void Error_Handler(void)
{
  /* USER CODE BEGIN Error_Handler_Debug */
  /* User can add his own implementation to report the HAL error return state */
  while(1)
  {
    /* Toggle LED3 */
    BSP_LED_Off(LED3);
    HAL_Delay(800);
    BSP_LED_On(LED3);
    HAL_Delay(10);
    BSP_LED_Off(LED3);
    HAL_Delay(180);
    BSP_LED_On(LED3);
    HAL_Delay(10);
  }
  /* USER CODE END Error_Handler_Debug */
}

/************************ (C) COPYRIGHT STMicroelectronics *****END OF FILE****/
